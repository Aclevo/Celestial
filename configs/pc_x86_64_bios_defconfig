## configs/pc_x86_64_bios_defconfig
```kconfig
BR2_x86_64=y
BR2_TOOLCHAIN_EXTERNAL=y
BR2_TOOLCHAIN_EXTERNAL_BOOTLIN_X86_64_GLIBC_STABLE=y
BR2_JLEVEL=4
BR2_SSP_REGULAR=y
BR2_TARGET_GENERIC_HOSTNAME="celestial"
BR2_TARGET_GENERIC_ISSUE="Welcome to Celestial linux"
BR2_ROOTFS_DEVICE_CREATION_DYNAMIC_EUDEV=y
BR2_TARGET_GENERIC_GETTY_PORT="tty1"
BR2_ROOTFS_POST_BUILD_SCRIPT="board/pc/post-build.sh"
BR2_ROOTFS_POST_IMAGE_SCRIPT="support/scripts/genimage.sh"
BR2_ROOTFS_POST_SCRIPT_ARGS="-c board/pc/genimage-bios.cfg"
BR2_LINUX_KERNEL=y
BR2_LINUX_KERNEL_CUSTOM_VERSION=y
BR2_LINUX_KERNEL_CUSTOM_VERSION_VALUE="6.1.24"
BR2_LINUX_KERNEL_USE_CUSTOM_CONFIG=y
BR2_LINUX_KERNEL_CUSTOM_CONFIG_FILE="board/pc/linux.config"
BR2_LINUX_KERNEL_INSTALL_TARGET=y
BR2_LINUX_KERNEL_NEEDS_HOST_OPENSSL=y
BR2_LINUX_KERNEL_NEEDS_HOST_LIBELF=y
BR2_PACKAGE_CELESTIAL_INSTALLER=y
BR2_PACKAGE_XORG7=y
BR2_PACKAGE_XSERVER_XORG_SERVER=y
BR2_PACKAGE_XCB_UTIL_WM=y
BR2_PACKAGE_XAPP_TWM=y
BR2_PACKAGE_XAPP_XINIT=y
BR2_PACKAGE_XAPP_XRANDR=y
BR2_PACKAGE_XDRIVER_XF86_INPUT_LIBINPUT=y
BR2_PACKAGE_XDRIVER_XF86_INPUT_MOUSE=y
BR2_PACKAGE_XDRIVER_XF86_VIDEO_CIRRUS=y
BR2_PACKAGE_XDRIVER_XF86_VIDEO_VESA=y
BR2_PACKAGE_XDRIVER_XF86_VIDEO_VOODOO=y
BR2_PACKAGE_XFONT_FONT_BH_TTF=y
BR2_PACKAGE_XTERM=y
BR2_PACKAGE_LINUX_FIRMWARE=y
BR2_PACKAGE_LINUX_FIRMWARE_ATHEROS_9170=y
BR2_PACKAGE_LINUX_FIRMWARE_ATHEROS_9271=y
BR2_PACKAGE_LINUX_FIRMWARE_IWLWIFI_3160=y
BR2_PACKAGE_LINUX_FIRMWARE_IWLWIFI_3168=y
BR2_PACKAGE_LINUX_FIRMWARE_IWLWIFI_5000=y
BR2_PACKAGE_LINUX_FIRMWARE_IWLWIFI_6000G2A=y
BR2_PACKAGE_LINUX_FIRMWARE_IWLWIFI_6000G2B=y
BR2_PACKAGE_LINUX_FIRMWARE_IWLWIFI_7260=y
BR2_PACKAGE_LINUX_FIRMWARE_IWLWIFI_7265D=y
BR2_PACKAGE_LINUX_FIRMWARE_IWLWIFI_8000C=y
BR2_PACKAGE_LINUX_FIRMWARE_IWLWIFI_8265=y
BR2_PACKAGE_LINUX_FIRMWARE_RALINK_RT73=y
BR2_PACKAGE_LINUX_FIRMWARE_RALINK_RT2XX=y
BR2_PACKAGE_LINUX_FIRMWARE_RTL_81XX=y
BR2_PACKAGE_LINUX_FIRMWARE_RTL_87XX=y
BR2_PACKAGE_LINUX_FIRMWARE_RTL_88XX=y
BR2_PACKAGE_LINUX_FIRMWARE_RTL_8169=y
BR2_PACKAGE_ACPID=y
BR2_PACKAGE_LIBGTK2=y
BR2_PACKAGE_CONNMAN=y
BR2_PACKAGE_CONNMAN_WIFI=y
BR2_PACKAGE_CONNMAN_CLIENT=y
BR2_PACKAGE_WIRELESS_REGDB=y
BR2_PACKAGE_OPKG=y
BR2_PACKAGE_NANO=y
BR2_TARGET_ROOTFS_CPIO_GZIP=y
BR2_TARGET_ROOTFS_ISO9660=y
# BR2_TARGET_ROOTFS_TAR is not set
BR2_TARGET_GRUB2=y
BR2_TARGET_GRUB2_BOOT_PARTITION="cd"
BR2_TARGET_GRUB2_BUILTIN_MODULES_PC="boot gzio iso9660 linux ext2 fat squash4 part_msdos part_gpt normal biosdisk"
BR2_TARGET_GRUB2_INSTALL_TOOLS=y
BR2_PACKAGE_HOST_E2FSPROGS=y
BR2_PACKAGE_HOST_GENIMAGE=y
```

## package/apt/Config.in
```kconfig
config BR2_PACKAGE_APT
	bool "apt"
	depends on BR2_PACKAGE_OPENSSL
	depends on BR2_PACKAGE_XXHASH
	depends on BR2_PACKAGE_LZ4
	depends on BR2_PACKAGE_ZLIB
	depends on BR2_PACKAGE_BERKELEYDB
	depends on BR2_PACKAGE_XZ
	depends on BR2_PACKAGE_BZIP2
	help
	 Command-line package manager for Debian and its derivates. It
	 provides command-line tools for searching and managing as well
	 as querying information about packages
	 
	 https://salsa.debian.org/apt-team/apt
```

## package/celestial/Config.in
```kconfig
config BR2_PACKAGE_CELESTIAL_INSTALLER
	bool "Celestial installer"
	help
	 Celestial linux installer
```

## package/dpkg/Config.in
```kconfig
config BR2_PACKAGE_DPKG
	bool "dpkg"
	depends on BR2_PACKAGE_GLIBC
	depends on BR2_PACKAGE_GLIBC_UTILS
	select BR2_PACKAGE_TAR
	select BR2_PACKAGE_LIBSELINUX
	select BR2_PACKAGE_LIBMD
	help
	 Debian packaging utilities
	 
	 https://snapshot.debian.org/
```

## package/triehash/Config.in.host
```kconfig
config BR2_PACKAGE_HOST_TRIEHASH
	bool "triehash"
	select BR2_PACKAGE_PERL
	help
	 Generator for order-preserving minimal
	 perfect hash functions in C
	 
	 https://jak-linux.org/projects/triehash
```

## package/ubiquity/Config.in
```kconfig
config BR2_PACKAGE_UBIQUITY
	bool "ubiquity"
	select BR2_PACKAGE_GOBJECT_INTROSPECTION
	select BR2_PACKAGE_PYTHON3 
	select BR2_PACKAGE_HOST_QEMU_SYSTEM_MODE
	help
		default ubuntu installer
```
